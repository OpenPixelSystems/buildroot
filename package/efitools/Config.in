## package/efitools/Config.in
```kconfig
config BR2_PACKAGE_EFITOOLS
	bool "efitools"
	depends on BR2_PACKAGE_GNU_EFI_ARCH_SUPPORTS \
		&& !BR2_RISCV_64
	select BR2_PACKAGE_GNU_EFI
	select BR2_PACKAGE_LIBOPENSSL_ENGINES
	select BR2_PACKAGE_OPENSSL
	select BR2_PACKAGE_OPENSSL_FORCE_LIBOPENSSL
	help
	  The efitools package provides utilities for managing UEFI
	  Secure Boot keys and includes sample EFI applications.
	  Binaries such as efi-readvar, efi-updatevar and
	  cert-to-efi-sig-list are built for the target system.

	  https://git.kernel.org/pub/scm/linux/kernel/git/jejb/efitools.git
```

## package/efitools/Config.in.host
```kconfig
config BR2_PACKAGE_HOST_EFITOOLS
	bool "host efitools"
	select BR2_PACKAGE_HOST_GNU_EFI
	select BR2_PACKAGE_HOST_LIBOPENSSL_ENGINES
	select BR2_PACKAGE_HOST_OPENSSL
	select BR2_PACKAGE_HOST_OPENSSL_FORCE_LIBOPENSSL
	help
	  The efitools package provides utilities for managing UEFI
	  Secure Boot keys and includes sample EFI applications.
	  Binaries such as efi-readvar, efi-updatevar and
	  cert-to-efi-sig-list are built for the target system.

	  https://git.kernel.org/pub/scm/linux/kernel/git/jejb/efitools.git
```

## package/imx-cst/Config.in.host
```kconfig
config BR2_PACKAGE_HOST_IMX_CST
	bool "host imx-cst"
	depends on BR2_arm || BR2_aarch64 # Only relevant for i.MX targets
	help
	  I.MX code signing tool provides software code signing
	  support designed that integrate the HABv4 and AHAB
	  library.

	  https://www.nxp.com/webapp/sps/download/license.jsp?colCode=IMX_CST_TOOL
```

## package/kernel-hardening-checker/Config.in.host
```kconfig
config BR2_PACKAGE_HOST_KERNEL_HARDENING_CHECKER
	bool "host kernel-hardening-checker"
	help
	  kernel-hardening-checker (formerly kconfig-hardened-check)
	  is a tool for checking the security hardening options of the
	  Linux kernel.

	  https://github.com/a13xp0p0v/kernel-hardening-checker
```

## package/openems/Config.in
```kconfig
menuconfig BR2_PACKAGE_OPENEMS
	bool "OpenEMS"
	help
	  OpenEMS is an open-source, modular platform designed
	  for energy management. It focuses on monitoring,
	  controlling, and integrating energy storage with
	  renewable energy sources. It also supports various
	  complementary devices and services, such as electric
	  vehicle charging stations, heat pumps, electrolysers,
	  and time-of-use electricity tariffs.
if BR2_PACKAGE_OPENEMS
source "package/openems/openems-edge/Config.in"
source "package/openems/openems-ui/Config.in"
endif
```

## package/openems/openems-edge/Config.in
```kconfig
config BR2_PACKAGE_OPENEMS_EDGE
	bool "OpenEMS Edge"
	depends on BR2_PACKAGE_OPENJDK
	help
	  runs on site, communicates with devices and
	  services, collects data and executes control
	  algorithms.

comment "OpenEMS Edge needs OpenJDK"
	depends on !BR2_PACKAGE_OPENJDK
```

## package/openems/openems-ui/Config.in
```kconfig
config BR2_PACKAGE_OPENEMS_UI
	bool "OpenEMS UI"
	help
	  Real-time user interface for web browsers and
	  smartphones.
```

## package/sbsigntools/Config.in
```kconfig
config BR2_PACKAGE_SBSIGNTOOLS
	bool "sbsigntools"
	depends on BR2_PACKAGE_GNU_EFI_ARCH_SUPPORTS
	depends on BR2_USE_WCHAR # binutils
	select BR2_PACKAGE_BINUTILS
	select BR2_PACKAGE_GNU_EFI
	select BR2_PACKAGE_LIBOPENSSL_ENGINES
	select BR2_PACKAGE_OPENSSL
	select BR2_PACKAGE_OPENSSL_FORCE_LIBOPENSSL
	select BR2_PACKAGE_UTIL_LINUX
	select BR2_PACKAGE_UTIL_LINUX_LIBUUID
	help
	  A Linux user-space application to sign and verify application
	  for UEFI Secure Boot.

	  https://git.kernel.org/pub/scm/linux/kernel/git/jejb/sbsigntools.git/about/

comment "sbsigntools needs a toolchain w/ wchar"
	depends on !BR2_USE_WCHAR
```

## package/sbsigntools/Config.in.host
```kconfig
config BR2_PACKAGE_HOST_SBSIGNTOOLS
	bool "host sbsigntools"
	select BR2_PACKAGE_HOST_BINUTILS
	select BR2_PACKAGE_HOST_GNU_EFI
	select BR2_PACKAGE_HOST_GNU_EFI
	select BR2_PACKAGE_HOST_LIBOPENSSL_ENGINES
	select BR2_PACKAGE_HOST_OPENSSL
	select BR2_PACKAGE_HOST_OPENSSL_FORCE_LIBOPENSSL
	select BR2_PACKAGE_HOST_UTIL_LINUX
	select BR2_PACKAGE_HOST_UTIL_LINUX_LIBUUID
	help
	  A Linux user-space application to sign and verify application
	  for UEFI Secure Boot.

	  https://git.kernel.org/pub/scm/linux/kernel/git/jejb/sbsigntools.git/about/
```

## package/uuu/Config.in
```kconfig
config BR2_PACKAGE_UUU
	bool "uuu"
	depends on BR2_INSTALL_LIBSTDCPP
	depends on BR2_USE_WCHAR # libuuu
	select BR2_PACKAGE_BZIP2
	select BR2_PACKAGE_OPENSSL
	select BR2_PACKAGE_LIBUSB
	select BR2_PACKAGE_TINYXML2
	select BR2_PACKAGE_ZLIB
	select BR2_PACKAGE_ZSTD
	help
	  UUU (Universal Update Utility) is Freescale/NXP I.MX Chip
	  image deploy tool. UUU is an evolution of MFGTools
	  (aka MFGTools v3).

	  https://github.com/nxp-imx/mfgtools

comment "uuu needs a toolchain w/ C++, wchar"
	depends on !BR2_USE_WCHAR || !BR2_INSTALL_LIBSTDCPP
```
