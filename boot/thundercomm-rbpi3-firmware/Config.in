## boot/thundercomm-rbpi3-firmware/Config.in
```kconfig
config BR2_TARGET_THUNDERCOMM_RBPI3_FIRMWARE
	bool "thundercomm-rubik-pi3-boot-firmware"
	depends on BR2_aarch64
	help
	  Bootloader and firmware files for Qualcomm-based RubikPi3
	  development board.

	  https://github.com/rubikpi-ai/boot-assets
```

## configs/thundercomm_rubik_pi3_defconfig
```kconfig
BR2_aarch64=y
BR2_TOOLCHAIN_EXTERNAL=y
BR2_TOOLCHAIN_EXTERNAL_BOOTLIN=y
BR2_TOOLCHAIN_EXTERNAL_BOOTLIN_AARCH64_GLIBC_STABLE=y
BR2_GLOBAL_PATCH_DIR="board/thundercomm/rubik-pi3/patches"
BR2_DOWNLOAD_FORCE_CHECK_HASHES=y
BR2_ROOTFS_DEVICE_CREATION_DYNAMIC_EUDEV=y
BR2_ROOTFS_POST_IMAGE_SCRIPT="board/thundercomm/rubik-pi3/post-image.sh"
BR2_LINUX_KERNEL=y
BR2_LINUX_KERNEL_CUSTOM_GIT=y
BR2_LINUX_KERNEL_CUSTOM_REPO_URL="https://github.com/qualcomm-linux/kernel.git"
BR2_LINUX_KERNEL_CUSTOM_REPO_VERSION="qcom-next"
BR2_LINUX_KERNEL_USE_ARCH_DEFAULT_CONFIG=y
BR2_LINUX_KERNEL_NEEDS_HOST_OPENSSL=y
BR2_LINUX_KERNEL_NEEDS_HOST_PYTHON3=y
BR2_TARGET_ROOTFS_EXT2=y
BR2_TARGET_ROOTFS_EXT2_4=y
BR2_TARGET_ROOTFS_EXT2_SIZE="200M"
# BR2_TARGET_ROOTFS_TAR is not set
BR2_TARGET_THUNDERCOMM_RBPI3_FIRMWARE=y
BR2_PACKAGE_HOST_DOSFSTOOLS=y
BR2_PACKAGE_HOST_GENIMAGE=y
BR2_PACKAGE_HOST_MTOOLS=y
BR2_PACKAGE_HOST_PTOOL=y
BR2_PACKAGE_HOST_QCA_SECTOOLS=y
```

## package/ptool/Config.in.host
```kconfig
config BR2_PACKAGE_HOST_PTOOL
	bool "host qualcomm ptool"
	select BR2_PACKAGE_HOST_PYTHON3
	help
	  qcom-ptool contains various device partitioning utilities
	  like ptool.py, gen_partitions.py and various sample
	  partition configuration files needed for Qualcomm SoCs.

	  https://github.com/qualcomm-linux/qcom-ptool

if BR2_PACKAGE_HOST_PTOOL

choice
	prompt "ptool platform"
	default BR2_PACKAGE_HOST_PTOOL_PLATFORM_RUBIKPI3

config BR2_PACKAGE_HOST_PTOOL_PLATFORM_RUBIKPI3
	bool "qcs6490-thundercomm-rubikpi3"
	help
	  Thundercomm RubikPi3 platform configuration for ptool.
endchoice

endif
```

## package/python-html5lib/Config.in.host
```kconfig
config BR2_PACKAGE_HOST_PYTHON_HTML5LIB
	bool "host python-html5lib"
	select BR2_PACKAGE_HOST_PYTHON_SIX # runtime
	select BR2_PACKAGE_HOST_PYTHON_WEBENCODINGS # runtime
	help
	  HTML parser based on the WHATWG HTML specification.

	  https://github.com/html5lib/html5lib-python
```

## package/python-webencodings/Config.in.host
```kconfig
config BR2_PACKAGE_HOST_PYTHON_WEBENCODINGS
	bool "host python-webencodings"
	help
	  Character encoding aliases for legacy web content.

	  https://github.com/SimonSapin/python-webencodings
```

## package/qca-sectools/Config.in.host
```kconfig
config BR2_PACKAGE_HOST_QCA_SECTOOLS
	bool "host qualcomm sectools"
	help
	  qualcomm sectools contain the tooling needed to build
	  and flash a secure image for a Qualcomm SoC

	  https://softwarecenter.qualcomm.com/catalog/item/Qualcomm_Security_Tools
```

## package/qt6/qt6webchannel/Config.in
```kconfig
config BR2_PACKAGE_QT6WEBCHANNEL
	bool "qt6webchannel"
	help
	  This package provides Qt6 WebChannel:

	  https://doc.qt.io/qt-6/qtwebchannel-index.html
	  https://code.qt.io/cgit/qt/qtwebchannel.git

if BR2_PACKAGE_QT6WEBCHANNEL

config BR2_PACKAGE_QT6WEBCHANNEL_QUICK
	bool "quick module"
	select BR2_PACKAGE_QT6DECLARATIVE_QUICK
endif
```

## package/qt6/qt6webengine/Config.in
```kconfig
config BR2_PACKAGE_QT6WEBENGINE_ARCH_SUPPORTS
	bool
	# https://code.qt.io/cgit/qt/qtwebengine.git/tree/configure.cmake?h=6.9.1#n309
	# May be extended to other arm variants later
	default y if BR2_aarch64 || BR2_x86_64 || (BR2_arm && BR2_ARM_CPU_ARMV7A)
	depends on BR2_HOSTARCH = "x86_64"

comment "qt6webengine needs udev /dev management and a glibc toolchain w/ host gcc >= 10"
	depends on BR2_PACKAGE_QT6WEBENGINE_ARCH_SUPPORTS
	depends on !BR2_PACKAGE_HAS_UDEV || !BR2_TOOLCHAIN_USES_GLIBC || \
		!BR2_HOST_GCC_AT_LEAST_10

comment "qt6webengine needs an OpenGL and EGL-capable backend"
	depends on BR2_PACKAGE_Q6WEBENGINE_ARCH_SUPPORTS
	depends on !BR2_PACKAGE_QT6_GL_SUPPORTS || !BR2_PACKAGE_HAS_LIBEGL

config BR2_PACKAGE_QT6WEBENGINE
	bool "qt6webengine"
	depends on BR2_PACKAGE_QT6WEBENGINE_ARCH_SUPPORTS
	# https://code.qt.io/cgit/qt/qtwebengine.git/tree/configure.cmake?h=6.9.1#n377
	depends on BR2_TOOLCHAIN_USES_GLIBC
	# https://code.qt.io/cgit/qt/qtwebengine.git/tree/configure.cmake?h=6.9.1#n501
	# https://code.qt.io/cgit/qt/qtwebengine.git/tree/configure.cmake?h=6.9.1#n14
	# https://code.qt.io/cgit/qt/qtwebengine.git/tree/configure.cmake?h=6.9.1#n263
	depends on BR2_HOST_GCC_AT_LEAST_10 # C++20
	depends on BR2_PACKAGE_QT6_GL_SUPPORTS
	depends on BR2_PACKAGE_HAS_LIBEGL
	depends on BR2_PACKAGE_HAS_UDEV
	depends on BR2_PACKAGE_HOST_PYTHON_HTML5LIB
	select BR2_PACKAGE_LIBNSS
	select BR2_PACKAGE_PYTHON_HTML5LIB
	select BR2_PACKAGE_DBUS
	select BR2_PACKAGE_FONTCONFIG
	select BR2_PACKAGE_HOST_QT6BASE_NETWORK
	select BR2_PACKAGE_QT6BASE_NETWORK
	# https://code.qt.io/cgit/qt/qtwebengine.git/tree/configure.cmake?h=6.9.1#n279
	select BR2_PACKAGE_QT6BASE_GUI
	select BR2_PACKAGE_QT6DECLARATIVE
	select BR2_PACKAGE_QT6DECLARATIVE_QUICK
	# https://code.qt.io/cgit/qt/qtwebengine.git/tree/configure.cmake?h=6.9.1#n270
	# https://code.qt.io/cgit/qt/qtwebengine.git/tree/configure.cmake?h=6.9.1#n9
	# https://code.qt.io/cgit/qt/qtwebengine.git/tree/.cmake.conf?h=6.9.1#n3
	select BR2_HOST_CMAKE_AT_LEAST_3_19
	#https://code.qt.io/cgit/qt/qtwebengine.git/tree/configure.cmake?h=6.9.1#n324
	select BR2_PACKAGE_HOST_NODEJS
	# https://code.qt.io/cgit/qt/qtwebengine.git/tree/configure.cmake?h=6.9.1#n439
	select BR2_PACKAGE_LIBDRM if BR2_PACKAGE_QT6BASE_XCB
	select BR2_PACKAGE_LIBXKBCOMMON if BR2_PACKAGE_QT6BASE_XCB
	select BR2_PACKAGE_XLIB_LIBX11 if BR2_PACKAGE_QT6BASE_XCB
	select BR2_PACKAGE_XLIB_LIBXCOMPOSITE if BR2_PACKAGE_QT6BASE_XCB
	select BR2_PACKAGE_XLIB_LIBXCURSOR if BR2_PACKAGE_QT6BASE_XCB
	select BR2_PACKAGE_XLIB_LIBXI if BR2_PACKAGE_QT6BASE_XCB
	select BR2_PACKAGE_XLIB_LIBXKBFILE if BR2_PACKAGE_QT6BASE_XCB
	select BR2_PACKAGE_XLIB_LIBXRANDR if BR2_PACKAGE_QT6BASE_XCB
	select BR2_PACKAGE_XLIB_LIBXSHMFENCE if BR2_PACKAGE_QT6BASE_XCB
	select BR2_PACKAGE_XLIB_LIBXTST if BR2_PACKAGE_QT6BASE_XCB
	select BR2_PACKAGE_XORGPROTO if BR2_PACKAGE_QT6BASE_XCB
	help
	  This package provides Qt6 WebEngine:

	  https://doc.qt.io/qt-6/qtwebengine-index.html
	  https://code.qt.io/cgit/qt/qtwebengine.git/

if BR2_PACKAGE_QT6WEBENGINE

config BR2_PACKAGE_QT6WEBENGINE_PROPRIETARY_CODECS
	bool "proprietary codecs"
	help
	  Enables the use of proprietary codecs such as h.264/h.265 and
	  MP3.

config BR2_PACKAGE_QT6WEBENGINE_SPELLCHECKER
	bool "spellchecker"
	help
	  Provides a spellchecker.

config BR2_PACKAGE_QT6WEBENGINE_WEBRTC
	bool "webrtc"
	# https://code.qt.io/cgit/qt/qtwebengine.git/tree/src/core/api/configure.cmake?h=6.9.1#n138
	select BR2_PACKAGE_XLIB_LIBXDAMAGE if BR2_PACKAGE_QT6BASE_XCB
	help
	  Provides WebRTC support.

endif
```
